<!-- pg_header.inc begin -->
<body bgColor=#ffffff leftMargin=0 topMargin=10 marginwidth="0" marginheight="0">
<div align=center style="width: 833; height: 470">
<table style="border: 1px solid #000080" height=384 cellSpacing=0 cellPadding=0 width="815">
 <tbody>
 <tr bgColor=#DDDDDD>
  <td style="border-bottom: 1px solid #000080" vAlign=bottom noWrap height=70 margin=50 width="567">
   <h2 align="center"><font face="verdana" color="#006699">S54MTB Krmilnik rotatorja</font></h2>
  </td>
  <td style="border-bottom: 1px solid #000080" vAlign=center noWrap height=78 width="170">
   <a href="http://ham.v4.si"><img border="0" src="logo_170.jpg" align="left" width="171" height="71"></a>
  </td>
  <td style="border-bottom: 1px solid #000080" align=center vAlign=center noWrap width="70"> 
   <a href="index.html"><font face="verdana" color="#003366"><H2>&#8962;</h2></font></a>
  </td>
 </tr>
 <tr>
  <td colSpan=5 height=380 width="815" vAlign=top bgColor=#ddeedd>
   <div align=center>
    <center><font face="verdana">
     <table width="90%" border=0 align=center>
      <tbody><tr>
       <td width="95%">
<!-- pg_header.inc end -->  
